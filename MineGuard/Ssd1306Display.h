/**
 * Ssd1306Display.h — minimal SSD1306 128x64 I2C OLED driver (header-only).
 *
 * Why this file exists: the toy truck's cab has an OLED screen so the driver
 * (and the AI/admin) can see messages without a laptop. It uses ONLY the
 * built-in Wire library — no Adafruit/U8g2 dependency — so the sketch
 * compiles anywhere with the default Arduino AVR core.
 *
 * If no OLED answers on I2C (0x3C), begin() returns false and every draw is
 * skipped silently: the truck works exactly the same, just without a screen.
 *
 * Memory: the Nano has 2 KB RAM, so this driver draws DIRECTLY to the panel
 * (no frame buffer) and keeps the 3x5 font in PROGMEM (flash). Cost: a few
 * extra I2C bytes per character — invisible next to the 10 Hz sensor loop.
 *
 * Wiring: SDA -> A4, SCL -> A5, VCC -> 5V (or 3.3V on some modules), GND.
 * The font is a hand-drawn 3x5 uppercase set (32 chars per line, 8 lines).
 */
#ifndef SSD1306_DISPLAY_H
#define SSD1306_DISPLAY_H

#include <Wire.h>
#include <string.h>
#include <avr/pgmspace.h>

class Ssd1306 {
public:
  bool ok = false;

  // Returns false (and disables all drawing) when no OLED is fitted.
  bool begin() {
    Wire.beginTransmission(0x3C);
    if (Wire.endTransmission() != 0) return false; // no ACK — no screen
    static const uint8_t INIT[] = {
      0xAE,             // display off
      0xD5, 0x80,       // clock divide
      0xA8, 0x3F,       // multiplex (64 rows)
      0xD3, 0x00,       // display offset
      0x40,             // start line 0
      0x8D, 0x14,       // charge pump on
      0x20, 0x00,       // horizontal addressing
      0xA1,             // segment remap
      0xC8,             // COM scan direction
      0xDA, 0x12,       // COM pins
      0x81, 0xCF,       // contrast
      0xD9, 0xF1,       // pre-charge
      0xDB, 0x40,       // VCOMH
      0xA4,             // resume to RAM content
      0xA6,             // normal (non-inverted)
      0xAF              // display on
    };
    for (uint8_t i = 0; i < sizeof(INIT); i++) {
      Wire.beginTransmission(0x3C);
      Wire.write(0x00); // command
      Wire.write(INIT[i]);
      Wire.endTransmission();
    }
    ok = true;
    clear();
    return true;
  }

  // Blank all 8 pages directly (no buffer to flush).
  void clear() {
    if (!ok) return;
    for (uint8_t page = 0; page < 8; page++) {
      Wire.beginTransmission(0x3C);
      Wire.write(0x00);
      Wire.write(0xB0 + page); // page address
      Wire.write(0x00);        // column low nibble
      Wire.write(0x10);        // column high nibble
      Wire.endTransmission();
      Wire.beginTransmission(0x3C);
      Wire.write(0x40); // data
      for (uint8_t x = 0; x < 128; x++) Wire.write(0x00);
      Wire.endTransmission();
    }
  }

  // One 3x5 glyph + 1px spacing = 4px advance; 8px line height.
  void text(uint8_t line, const char* s) {
    if (!ok) return;
    uint8_t x = 0;
    while (*s && x < 124) {
      drawChar(x, line, (uint8_t)*s++);
      x += 4;
    }
  }

private:
  // Column-major 3x5 font in PROGMEM: 5 bytes per glyph, each byte is one
  // 8-pixel-tall column (5 rows used). Covers 0x20 (space) .. 0x60.
  static const uint8_t FONT[];

  static const uint8_t* glyph(uint8_t c) {
    if (c >= 0x20 && c <= 0x60) return FONT + (c - 0x20) * 5;
    return FONT + ('?' - 0x20) * 5; // unknown -> '?'
  }

  // Draw one glyph straight to the panel: move the cursor, push 5 columns.
  void drawChar(uint8_t x, uint8_t line, uint8_t c) {
    const uint8_t* g = glyph(c);
    Wire.beginTransmission(0x3C);
    Wire.write(0x00);
    Wire.write(0xB0 + line);          // page = line
    Wire.write(0x00 | (x & 0x0F));    // column low nibble
    Wire.write(0x10 | ((x >> 4) & 0x07)); // column high nibble
    Wire.endTransmission();
    Wire.beginTransmission(0x3C);
    Wire.write(0x40); // data
    for (uint8_t col = 0; col < 5; col++) Wire.write(pgm_read_byte(g + col));
    Wire.endTransmission();
  }
};

// The font table itself (out of class — AVR GCC cannot initialise a static
// array inside the class body).
const uint8_t Ssd1306::FONT[] PROGMEM = {
  0x00,0x00,0x00,0x00,0x00, // space
  0x00,0x17,0x00,0x00,0x00, // !
  0x03,0x00,0x03,0x00,0x00, // "
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  0x02,0x05,0x02,0x00,0x00, // ° (degree)
};

#endif
